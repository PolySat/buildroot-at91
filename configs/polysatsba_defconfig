## configs/polysatsba_defconfig
```kconfig
# Architecture
BR2_arm=y
BR2_arm926t=y

# Toolchains
BR2_TOOLCHAIN_BUILDROOT_LARGEFILE=y
BR2_TOOLCHAIN_BUILDROOT_INET_IPV6=y
BR2_TOOLCHAIN_BUILDROOT_WCHAR=y
BR2_TOOLCHAIN_BUILDROOT_LOCALE=y
BR2_TOOLCHAIN_BUILDROOT_CXX=y
BR2_PTHREADS_NATIVE=y

# System configuration
BR2_TARGET_GENERIC_GETTY_PORT="ttyS0"
BR2_TARGET_GENERIC_GETTY_BAUDRATE_115200=y
BR2_TARGET_GENERIC_GETTY_BAUDRATE="115200"
BR2_SYSTEM_DEFAULT_PATH="/bin:/sbin:/usr/bin:/usr/sbin:/usr/local/bin:/usr/local/sbin"

# BusyBox
BR2_PACKAGE_BUSYBOX_CONFIG="package/busybox/busybox.polysat.config"
BR2_PACKAGE_BUSYBOX_SHOW_OTHERS=y

# Kernel
BR2_LINUX_KERNEL=y
BR2_LINUX_KERNEL_LATEST_VERSION=y
BR2_LINUX_KERNEL_VERSION="5.15.45"
BR2_LINUX_KERNEL_USE_CUSTOM_CONFIG=y
BR2_LINUX_KERNEL_CUSTOM_CONFIG_FILE="board/intrepid/linux-config"
BR2_LINUX_KERNEL_NEEDS_HOST_OPENSSL=y

# Filesystem
BR2_PREFER_USR_LOCAL=y
BR2_TARGET_SEPARATE_USR_LOCAL=y
BR2_TARGET_ROOTFS_TAR=y
BR2_TARGET_ROOTFS_UBI=y
BR2_TARGET_ROOTFS_UBI_PEBSIZE=0x20000
BR2_TARGET_ROOTFS_UBI_SUBSIZE=512
BR2_TARGET_ROOTFS_UBIFS=y
BR2_TARGET_ROOTFS_UBIFS_LEBSIZE=0x1f800
BR2_TARGET_ROOTFS_UBIFS_MINIOSIZE=0x800
BR2_TARGET_ROOTFS_UBIFS_MAXLEBCNT=2047
BR2_TARGET_ROOTFS_CPIO=y
BR2_TARGET_ROOTFS_CPIO_BZIP2=y

# Bootloaders
BR2_TARGET_AT91BOOTSTRAP3=y
BR2_TARGET_AT91BOOTSTRAP3_CUSTOM_GIT=y
BR2_TARGET_AT91BOOTSTRAP3_CUSTOM_REPO_URL="https://github.com/linux4sam/at91bootstrap.git"
BR2_TARGET_AT91BOOTSTRAP3_CUSTOM_REPO_VERSION="v3.10.3"
BR2_TARGET_AT91BOOTSTRAP3_DEFCONFIG="at91sam9g20eknf_uboot"
BR2_TARGET_UBOOT=y
BR2_TARGET_UBOOT_BUILD_SYSTEM_KCONFIG=y
BR2_TARGET_UBOOT_CUSTOM_VERSION=y
BR2_TARGET_UBOOT_CUSTOM_VERSION_VALUE="2016.09.01"
BR2_TARGET_UBOOT_BOARD_DEFCONFIG="at91sam9g20ek_nandflash"

# Packages
BR2_PACKAGE_BZIP2=y
BR2_PACKAGE_LZOP=y
BR2_PACKAGE_XZ=y
BR2_PACKAGE_BSDIFF=y
#BR2_PACKAGE_EPEG=y
BR2_PACKAGE_IMAGEMAGICK=y
BR2_PACKAGE_E2FSPROGS=y
#BR2_PACKAGE_E2FSPROGS_BADBLOCKS=y
#BR2_PACKAGE_E2FSPROGS_CHATTR=y
#BR2_PACKAGE_E2FSPROGS_DUMPE2FS=y
#BR2_PACKAGE_E2FSPROGS_E2FREEFRAG=y
#BR2_PACKAGE_E2FSPROGS_E2FSCK=y
#BR2_PACKAGE_E2FSPROGS_E2LABEL=y
#BR2_PACKAGE_E2FSPROGS_E2UNDO=y
#BR2_PACKAGE_E2FSPROGS_FILEFRAG=y
#BR2_PACKAGE_E2FSPROGS_FINDFS=y
#BR2_PACKAGE_E2FSPROGS_FSCK=y
#BR2_PACKAGE_E2FSPROGS_LOGSAVE=y
#BR2_PACKAGE_E2FSPROGS_LSATTR=y
#BR2_PACKAGE_E2FSPROGS_MKE2FS=y
#BR2_PACKAGE_E2FSPROGS_MKLOSTFOUND=y
#BR2_PACKAGE_E2FSPROGS_TUNE2FS=y
#BR2_PACKAGE_E2FSPROGS_UUIDGEN=y
BR2_PACKAGE_I2C_TOOLS=y
BR2_PACKAGE_MTD=y
BR2_PACKAGE_MTD_FLASHCP=y
BR2_PACKAGE_MTD_FLASH_ERASE=y
BR2_PACKAGE_MTD_FLASH_LOCK=y
BR2_PACKAGE_MTD_FLASH_UNLOCK=y
BR2_PACKAGE_MTD_MKFSJFFS2=y
BR2_PACKAGE_MTD_MTD_DEBUG=y
BR2_PACKAGE_MTD_NANDDUMP=y
BR2_PACKAGE_MTD_NANDTEST=y
BR2_PACKAGE_MTD_NANDWRITE=y
BR2_PACKAGE_MTD_MTDINFO=y
BR2_PACKAGE_PICOCOM=y

BR2_PACKAGE_PYTHON3=y
BR2_PACKAGE_PYTHON_SERIAL=y

### Presumed old options
#BR2_PACKAGE_PYTHON_PYC_ONLY=y 
#BR2_PACKAGE_PYTHON_BZIP2=y
#BR2_PACKAGE_PYTHON_CURSES=y
#BR2_PACKAGE_PYTHON_READLINE=y
#BR2_PACKAGE_PYTHON_SSL=y
#BR2_PACKAGE_PYTHON_UNICODEDATA=y
#BR2_PACKAGE_PYTHON_SQLITE=y
#BR2_PACKAGE_PYTHON_ZLIB=y
#BR2_PACKAGE_PYTHON_SERIAL=y

BR2_PACKAGE_LZO=y
BR2_PACKAGE_ZLIB=y
BR2_PACKAGE_LIBOPENSSL=y
BR2_PACKAGE_LIBOPENSSL_BIN=y
BR2_PACKAGE_LIBOPENSSL_ENGINES=y
BR2_PACKAGE_SQLITE=y
BR2_PACKAGE_LIBJPEG=y
BR2_PACKAGE_JPEG=y
BR2_PACKAGE_JASPER=y

BR2_PACKAGE_LIBEXIF=y
BR2_PACKAGE_LIBPNG=y
BR2_PACKAGE_LIBPCAP=y
BR2_PACKAGE_ZEROMQ=y
BR2_PACKAGE_LIBATOMIC_OPS=y
BR2_PACKAGE_LIBFFI=y
#BR2_PACKAGE_MESCHACH=y
BR2_PACKAGE_NCURSES=y
#BR2_PACKAGE_NCURSES_TARGET_PANEL=y
#BR2_PACKAGE_NCURSES_TARGET_FORM=y
#BR2_PACKAGE_NCURSES_TARGET_MENU=y
BR2_PACKAGE_POPT=y
BR2_PACKAGE_READLINE=y
BR2_PACKAGE_EXPAT=y
BR2_PACKAGE_CPULIMIT=y
BR2_PACKAGE_DROPBEAR=y
BR2_PACKAGE_DROPBEAR_DISABLE_REVERSEDNS=y
BR2_PACKAGE_DROPBEAR_SMALL=y

BR2_PACKAGE_INETUTILS=y
BR2_PACKAGE_INETUTILS_FTPD=y
#BR2_PACKAGE_INETUTILS_RCP=y
#BR2_PACKAGE_INETUTILS_REXEC=y
#BR2_PACKAGE_INETUTILS_REXECD=y
#BR2_PACKAGE_INETUTILS_RLOGIN=y
#BR2_PACKAGE_INETUTILS_RSH=y
BR2_PACKAGE_NETCAT=y
BR2_PACKAGE_NTP=y
BR2_PACKAGE_NTP_NTPD=y
BR2_PACKAGE_NTP_NTPDATE=y
BR2_PACKAGE_PPPD=y
BR2_PACKAGE_RSH_REDONE=y
BR2_PACKAGE_RSH_REDONE_RLOGIN=y
BR2_PACKAGE_RSH_REDONE_RSH=y
BR2_PACKAGE_RSYNC=y
BR2_PACKAGE_CPIO=y
BR2_PACKAGE_INOTIFY_TOOLS=y
BR2_PACKAGE_LOGROTATE=y
BR2_PACKAGE_UTIL_LINUX=y
BR2_PACKAGE_UTIL_LINUX_MOUNT=y
BR2_PACKAGE_UTIL_LINUX_FSCK=y
BR2_PACKAGE_UTIL_LINUX_LIBUUID=y
BR2_PACKAGE_UTIL_LINUX_LIBBLKID=y
BR2_PACKAGE_UTIL_LINUX_INIT=y
BR2_PACKAGE_UTIL_LINUX_KILL=y
BR2_PACKAGE_HOST_LCM=y

BR2_PACKAGE_POLYSAT_BINARIES=y

# PolySat Packages
BR2_PACKAGE_LIBPROC=y
BR2_PACKAGE_LIBPROC_version_head=y
BR2_PACKAGE_LIBROHC=y
BR2_PACKAGE_UVCCAPTURE=y
BR2_PACKAGE_UVCCAPTURE_version_custom=y
BR2_PACKAGE_UVCCAPTURE_CONFIG_CUSTOM_VERSION_STR="v1.0"
BR2_PACKAGE_LIBGPIO=y
BR2_PACKAGE_LIBGPIO_version_custom=y
BR2_PACKAGE_LIBGPIO_CONFIG_CUSTOM_VERSION_STR="v1.0"
BR2_PACKAGE_LIBSATPKT=y
BR2_PACKAGE_LIBSATPKT_version_custom=y
BR2_PACKAGE_LIBSATPKT_CONFIG_CUSTOM_VERSION_STR="v2.47"
BR2_PACKAGE_LIBPOLYDRIVERS=y
BR2_PACKAGE_LIBPOLYDRIVERS_version_custom=y
BR2_PACKAGE_LIBPOLYDRIVERS_CONFIG_CUSTOM_VERSION_STR="v2.94"
BR2_PACKAGE_WD_TAP=y
BR2_PACKAGE_WD_TAP_version_custom=y
BR2_PACKAGE_WD_TAP_CONFIG_CUSTOM_VERSION_STR="v1.2"
BR2_PACKAGE_CLKSYNC=y
BR2_PACKAGE_CLKSYNC_version_custom=y
BR2_PACKAGE_CLKSYNC_CONFIG_CUSTOM_VERSION_STR="v1.05"
BR2_PACKAGE_BEACON=y
BR2_PACKAGE_BEACON_version_custom=y
BR2_PACKAGE_BEACON_CONFIG_CUSTOM_VERSION_STR="v2.22"
BR2_PACKAGE_BEACON_fmt_1U=y
BR2_PACKAGE_LIBPOLYDB=y
BR2_PACKAGE_LIBPOLYDB_version_custom=y
BR2_PACKAGE_LIBPOLYDB_CONFIG_CUSTOM_VERSION_STR="v1.14"
BR2_PACKAGE_ARSFTP=y
BR2_PACKAGE_ARSFTP_version_custom=y
BR2_PACKAGE_ARSFTP_CONFIG_CUSTOM_VERSION_STR="v0.87"
BR2_PACKAGE_TELEMETRY=y
BR2_PACKAGE_TELEMETRY_version_custom=y
BR2_PACKAGE_TELEMETRY_CONFIG_CUSTOM_VERSION_STR="v1.16"
BR2_PACKAGE_POLYSAT_WATCHDOG=y
BR2_PACKAGE_POLYSAT_WATCHDOG_version_custom=y
BR2_PACKAGE_POLYSAT_WATCHDOG_CONFIG_CUSTOM_VERSION_STR="v2.06"
BR2_PACKAGE_DB_EXPORT=y
BR2_PACKAGE_DB_EXPORT_version_custom=y
BR2_PACKAGE_DB_EXPORT_CONFIG_CUSTOM_VERSION_STR="v2.01"
# Currently broken
#BR2_PACKAGE_DB_CLEANER=y
#BR2_PACKAGE_DB_CLEANER_version_custom=y
#BR2_PACKAGE_DB_CLEANER_CONFIG_CUSTOM_VERSION_STR="v0.41"
BR2_PACKAGE_LIBFSM=y
BR2_PACKAGE_LIBFSM_version_custom=y
BR2_PACKAGE_LIBFSM_CONFIG_CUSTOM_VERSION_STR="v1.0.6"
BR2_PACKAGE_DATALOGGER=y
BR2_PACKAGE_DATALOGGER_version_custom=y
BR2_PACKAGE_DATALOGGER_CONFIG_CUSTOM_VERSION_STR="v1.89"
#BR2_PACKAGE_SYS_MANAGER=y
#BR2_PACKAGE_SYS_MANAGER_version_custom=y
#BR2_PACKAGE_SYS_MANAGER_CONFIG_CUSTOM_VERSION_STR="v1.90"


# Not ready for auto-telem yet
#BR2_PACKAGE_POLYSAT_WATCHDOG_AUTOTELEM=y

# Host packages
BR2_PACKAGE_HOST_SAM_BA=y
BR2_PACKAGE_HOST_POLYXDR=y
BR2_PACKAGE_HOST_LIBPROC=y
BR2_PACKAGE_HOST_LIBSATPKT=y
BR2_PACKAGE_HOST_ARSFTP=y
BR2_PACKAGE_HOST_LIBPOLYDB=y
BR2_PACKAGE_HOST_LIBPOLYDRIVERS=y
BR2_PACKAGE_HOST_POLYSAT_WATCHDOG=y
BR2_PACKAGE_HOST_DB_EXPORT=y
BR2_PACKAGE_HOST_LIBFSM=y
BR2_PACKAGE_HOST_DATALOGGER=y
#BR2_PACKAGE_HOST_SYS_MANAGER=y
```

## package/polysat/Config.in
```kconfig
menu "PolySat Libraries and tools"
	source "package/polysat/libproc/Config.in"
	source "package/polysat/uvccapture/Config.in"
endmenu

menu "Misc libraries"
	source "package/polysat/librohc/Config.in"
	source "package/polysat/libgpio/Config.in"
endmenu
```

## package/polysat/Config.in.host
```kconfig
menu "PolySat Host utilities"
	source "package/polysat/polyxdr/Config.in.host"
	source "package/polysat/libproc/Config.in.host"
	source "package/polysat/libgpio/Config.in.host"
endmenu
```

## package/polysat/libgpio/Config.in
```kconfig
config BR2_PACKAGE_LIBGPIO
    bool "PolySat GPIO Library"
    help
        Polysat's gpio library code.

choice
   prompt "libgpio Version"
   depends on BR2_PACKAGE_LIBGPIO
   default BR2_PACKAGE_LIBGPIO_version_head
   help
      The git version of the libgpio code to use

   config BR2_PACKAGE_LIBGPIO_version_head
      bool "HEAD"

   config BR2_PACKAGE_LIBGPIO_version_custom
      bool "Manually specify git tag to build"

   config BR2_PACKAGE_LIBGPIO_version_1
      bool "1.0"

endchoice

config BR2_PACKAGE_LIBGPIO_CONFIG_CUSTOM_VERSION_STR
   string "libgpio version"
   depends on BR2_PACKAGE_LIBGPIO
   depends on BR2_PACKAGE_LIBGPIO_version_custom
   help
      Custom git tag to build.
```

## package/polysat/libgpio/Config.in.host
```kconfig
config BR2_PACKAGE_HOST_LIBGPIO
    bool "PolySat GPIO Library"
    help
        Polysat's gpio library code.
```

## package/polysat/libproc/Config.in
```kconfig
config BR2_PACKAGE_LIBPROC
    bool "PolySat Process Library"
    select BR2_PACKAGE_HOST_POLYXDR
    help
        Polysat's process library code.

choice
   prompt "version"
   depends on BR2_PACKAGE_LIBPROC
   default BR2_PACKAGE_LIBPROC_version_head
   help
      The git version of the code to use

   config BR2_PACKAGE_LIBPROC_version_head
      bool "HEAD"

   config BR2_PACKAGE_LIBPROC_version_custom
      bool "Specify a custom git tag"
endchoice

config BR2_PACKAGE_LIBPROC_CONFIG_CUSTOM_VERSION_STR
   string "libproc process version"
   depends on BR2_PACKAGE_LIBPROC
   depends on BR2_PACKAGE_LIBPROC_version_custom
   help
      Custom git tag to build.
```

## package/polysat/libproc/Config.in.host
```kconfig
config BR2_PACKAGE_HOST_LIBPROC
    bool "PolySat Process Library"
    select BR2_PACKAGE_HOST_POLY_XDRGEN
    help
        Polysat's process library code.
```

## package/polysat/polyxdr/Config.in.host
```kconfig
config BR2_PACKAGE_HOST_POLYXDR
	bool "host polyxdr"
	select BR2_PACKAGE_HOST_PYTHON_PYPARSING
	select BR2_PACKAGE_HOST_PYTHON_TENJIN
	help
	  polyxdr is a customized xdr schema parser and generator used
	  by PolySat in their process library.

	  https://github.com/PolySat/polyxdr
```

## package/python-tenjin/Config.in.host
```kconfig
config BR2_PACKAGE_HOST_PYTHON_TENJIN
	bool "host-python-tenjin"
	help
	  pyTenjin is a very fast and full-featured template engine.
          You can embed Python statements and expressions into your
          template file. pyTenjin converts it into Python script
          and evaluate it.

	  https://pypi.org/project/Tenjin/
```
